## src/mainboard/cwwk/adl/Kconfig
```kconfig
## SPDX-License-Identifier: GPL-2.0-or-later

config BOARD_CWWK_ADL_N_COMMON
	def_bool y
	select BOARD_ROMSIZE_KB_16384
	select CRB_TPM
	select DRIVERS_UART_8250IO if !BOARD_CWWK_CW_NAS_ADLN_K
	select FSP_TYPE_IOT
	select HAVE_ACPI_RESUME
	select HAVE_ACPI_TABLES
	select HAVE_INTEL_PTT
	select INTEL_GMA_HAVE_VBT
	select SOC_INTEL_ALDERLAKE_PCH_N
	select SUPERIO_ITE_IT8613E

config BOARD_CWWK_CW_ADL_4L_V1
	select BOARD_CWWK_ADL_N_COMMON

config BOARD_CWWK_CW_ADLNTB_1C2L_V3
	select BOARD_CWWK_ADL_N_COMMON

config BOARD_CWWK_CW_NAS_ADLN_K
	select BOARD_CWWK_ADL_N_COMMON
	select NO_UART_ON_SUPERIO
	select MAINBOARD_HAS_TPM2
	select SOC_INTEL_COMMON_BLOCK_HDA_VERB

config CWWK_SIO_GPIO_UART
	bool "Use a GPIO header pin for debug serial output"
	depends on BOARD_CWWK_CW_NAS_ADLN_K
	default n
	select HAVE_UART_SPECIAL
	select FIXED_UART_FOR_CONSOLE
	select UART_OVERRIDE_BAUDRATE
	help
	  Bit-bang a transmit-only 3.3 V console on one signal pin of the
	  GPIO header; the board has no COM header. There is no receive line
	  and no UART for the payload or OS. Nothing is sent from SMM, where
	  the OS may be using the Super I/O.

config CWWK_SIO_GPIO_UART_BAUD
	int "GPIO serial baud rate"
	depends on CWWK_SIO_GPIO_UART
	range 9600 38400
	default 38400
	help
	  Configure the receiving adapter to the same rate. The software UART
	  does not support rates above 38400 baud.

config CWWK_SIO_GPIO_UART_TX_PIN
	int "GPIO header pin for serial TX (1-8)"
	depends on CWWK_SIO_GPIO_UART
	range 1 8
	default 1
	help
	  GPIO header signal pin: 1=GP10, 2=GP22, 3=GP31, 4=GP32,
	  5=GP33, 6=GP41, 7=GP45, 8=GP63. Connect it to the adapter RX.

if BOARD_CWWK_ADL_N_COMMON

config MAINBOARD_DIR
	default "cwwk/adl"

config VARIANT_DIR
	default "cw-adl-4l-v1.0"      if BOARD_CWWK_CW_ADL_4L_V1
	default "cw-adlntb-1c2l-v3.0" if BOARD_CWWK_CW_ADLNTB_1C2L_V3
	default "cw-nas-adln-k" if BOARD_CWWK_CW_NAS_ADLN_K

config MAINBOARD_PART_NUMBER
	default "CW-ADL-4L-V1.0"      if BOARD_CWWK_CW_ADL_4L_V1
	default "CW-ADLNTB-1C2L-V3.0" if BOARD_CWWK_CW_ADLNTB_1C2L_V3
	default "CW-NAS-ADLN-K" if BOARD_CWWK_CW_NAS_ADLN_K

config MAINBOARD_SMBIOS_PRODUCT_NAME
	default "CW-ADL-4L-V1.0"      if BOARD_CWWK_CW_ADL_4L_V1
	default "CW-X86-P5-V3"        if BOARD_CWWK_CW_ADLNTB_1C2L_V3
	default "CW-NAS-ADLN-K" if BOARD_CWWK_CW_NAS_ADLN_K

config MAINBOARD_VERSION
	default "CW-ADL-4L-V1.0"      if BOARD_CWWK_CW_ADL_4L_V1
	default "CW-ADLNTB-1C2L-V3.0" if BOARD_CWWK_CW_ADLNTB_1C2L_V3
	default "CW-NAS-ADLN-K" if BOARD_CWWK_CW_NAS_ADLN_K

# Override the default variant behavior, since the data.vbt is the same
config INTEL_GMA_VBT_FILE
	default "src/mainboard/\$(MAINBOARDDIR)/data.vbt"

config DEVICETREE
	default "devicetree_nas_k.cb" if BOARD_CWWK_CW_NAS_ADLN_K

config NO_POST
	default y

# The vendor firmware rewrites its variable store at the start of the BIOS region after an
# update from its own OS tools; keep coreboot data out of that range.
config FMDFILE
	default "src/mainboard/\$(CONFIG_MAINBOARD_DIR)/nas_k_ami_safe.fmd" if BOARD_CWWK_CW_NAS_ADLN_K

# The TCSS ports are wired as Type-A without a USB4 topology; the board ACPI has no D3cold support.
config D3COLD_SUPPORT
	default n if BOARD_CWWK_CW_NAS_ADLN_K

endif
```
